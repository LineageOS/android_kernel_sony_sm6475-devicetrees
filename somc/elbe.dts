/dts-v1/;

#include "../qcom/parrot.dts"
#include "elbe-pinctrl.dtsi"
#include "elbe-pmic.dtsi"
#include "elbe-regulators.dtsi"
#include "elbe-reserved-memory.dtsi"
#include "elbe-sdhc.dtsi"
#include "elbe-usb.dtsi"

/ {
	model = "Sony Mobile Communications - elbe";
};
